AUTOSAR XML (schema 4-2-0)
package /VehicleControlSystem  # Vehicle Control System Package
  element EngineControlModule  # Engine Control Module
    3 x :
      EngineConfiguration  # Engine Configuration Parameters
        parameter MaxRPM: value=6500  # Maximum Engine RPM
        parameter IdleRPM: value=750  # Idle Engine RPM
        parameter RedlineRPM: value=7000  # Redline Engine RPM
      EngineSensors  # Engine Sensor Configuration
        element TemperatureSensor  # Engine Temperature Sensor
          parameter SensorType: value=THERMISTOR  # Temperature Sensor Type
          parameter CalibrationFactor: value=0.1  # Temperature Calibration Factor
        element PressureSensor  # Engine Oil Pressure Sensor
          parameter SensorType: value=PIEZOELECTRIC  # Pressure Sensor Type
          parameter MaxPressure: value=10.0  # Maximum Measurable Pressure
        element RPM_Sensor  # Engine RPM Sensor
          parameter SensorType: value=HALL_EFFECT  # RPM Sensor Type
          parameter PulsesPerRevolution: value=60  # Pulses Per Engine Revolution
      EngineActuators  # Engine Actuator Configuration
        element ThrottleValve  # Electronic Throttle Valve
          parameter MaxOpening: value=90  # Maximum Throttle Opening
          parameter MinOpening: value=5  # Minimum Throttle Opening
        element FuelInjector  # Fuel Injection System
          parameter InjectionTiming: value=0.0  # Fuel Injection Timing
          parameter InjectionDuration: value=2.5  # Fuel Injection Duration
  element TransmissionControlModule  # Transmission Control Module
    TransmissionConfiguration ()  # Transmission Configuration Parameters
      parameter NumberOfGears: value=6  # Number of Transmission Gears
      parameter GearRatios: value=3.5,2.1,1.4,1.0,0.8,0.6  # Transmission Gear Ratios
    TransmissionSensors ()  # Transmission Sensor Configuration
      element GearPositionSensor  # Gear Position Sensor
        parameter SensorType: value=ENCODER  # Gear Position Sensor Type
        parameter Resolution: value=360  # Sensor Resolution
      element TransmissionTemperatureSensor  # Transmission Temperature Sensor
        parameter SensorType: value=THERMISTOR  # Temperature Sensor Type
        parameter OperatingRange: value=-40,150  # Operating Temperature Range
  element BrakeControlModule  # Brake Control Module
    BrakeConfiguration ()  # Brake System Configuration
      parameter MaxBrakeForce: value=1000  # Maximum Brake Force
      parameter BrakeAssistLevel: value=HIGH  # Brake Assist Level
    BrakeSensors ()  # Brake Sensor Configuration
      element BrakePedalSensor  # Brake Pedal Position Sensor
        parameter SensorType: value=POTENTIOMETER  # Pedal Sensor Type
        parameter TravelRange: value=100  # Pedal Travel Range
      element WheelSpeedSensor  # Wheel Speed Sensor
        parameter SensorType: value=HALL_EFFECT  # Wheel Speed Sensor Type
        parameter PulsesPerRevolution: value=48  # Pulses Per Wheel Revolution
