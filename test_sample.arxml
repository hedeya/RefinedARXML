AUTOSAR XML (schema 4-2-0)
package /TestPackage  # Test Package for Hierarchy Visualization
  element EngineControl  # Engine Control Software Component
    EngineParams ()  # Engine Parameters
      parameter MaxRPM: value=6000  # Maximum RPM
      parameter IdleRPM: value=800  # Idle RPM
    EngineSensors ()  # Engine Sensors
      element TemperatureSensor  # Temperature Sensor
      element PressureSensor  # Pressure Sensor
  element TransmissionControl  # Transmission Control Software Component
    GearParams ()  # Gear Parameters
      parameter MaxGear: value=6  # Maximum Gear
