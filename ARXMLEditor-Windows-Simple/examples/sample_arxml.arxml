AUTOSAR XML (schema 4-2-0)
package /SamplePackage  # Sample ARXML Package
  element SampleElement  # Sample ARXML Element
    SampleContainer ()  # Sample Container
      parameter SampleParameter: value=SampleValue  # Sample Parameter
