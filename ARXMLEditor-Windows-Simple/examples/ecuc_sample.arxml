AUTOSAR XML (schema 4-2-0)
package /ECUCPackage  # ECUC Configuration Package
  ecuc value collection EcuC: definition=/AUTOSAR/EcuC  # ECU Configuration
    ecuc param conf container value EcuCGeneral: definition=/AUTOSAR/EcuC/EcuCGeneral, parameters={EcuCName=SampleECU, EcuCMainFunctionPeriod=10, EcuCEnableWakeupSource=true}  # ECU General Configuration
